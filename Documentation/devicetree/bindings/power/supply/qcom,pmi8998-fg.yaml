## Documentation/devicetree/bindings/power/supply/qcom,pmi8998-fg.yaml
```yaml
# SPDX-License-Identifier: (GPL-2.0-only OR BSD-2-Clause)
%YAML 1.2
---
$id: http://devicetree.org/schemas/power/supply/qcom,pmi8998-fg.yaml#
$schema: http://devicetree.org/meta-schemas/core.yaml#

title: Qualcomm PMI8998 PMIC Fuel Gauge

maintainers:
  - Casey Connolly <casey@connolly.tech>
  - Joel Selvaraj <foss@joelselvaraj.com>
  - Yassine Oudjana <y.oudjana@protonmail.com>

description:
  The third generation fuel gauge (FG Gen3) of the PMI8998 PMIC measures the
  battery voltage, current and temperature and runs a state of charge
  algorithm inside the PMIC. It is made of the FG_BATT_SOC, FG_BATT_INFO and
  FG_MEM_IF peripherals, each with its own 0x100 byte register window.

allOf:
  - $ref: power-supply.yaml#

properties:
  compatible:
    const: qcom,pmi8998-fg

  reg:
    items:
      - description: FG_BATT_SOC peripheral (state of charge)
      - description: FG_BATT_INFO peripheral (battery measurements)
      - description: FG_MEM_IF peripheral (FG SRAM access)

  monitored-battery:
    description:
      The simple-battery node of the battery. Its constant data
      (charge-full-design-microamp-hours, voltage-min-design-microvolt, ...)
      is reported for the battery; voltage-min-design-microvolt is also used
      as the empty threshold.

  power-supplies:
    description:
      The charger feeding the battery. The charging status is taken from it.

required:
  - compatible
  - reg
  - monitored-battery

additionalProperties: false

examples:
  - |
    pmic {
      #address-cells = <1>;
      #size-cells = <0>;

      fuel-gauge@4000 {
        compatible = "qcom,pmi8998-fg";
        reg = <0x4000>, <0x4100>, <0x4400>;

        monitored-battery = <&battery>;
        power-supplies = <&pmi8998_charger>;
      };
    };
```

## Documentation/devicetree/bindings/soc/qcom/qcom,msm8998-gfx-mem-acc.yaml
```yaml
# SPDX-License-Identifier: (GPL-2.0-only OR BSD-2-Clause)
%YAML 1.2
---
$id: http://devicetree.org/schemas/soc/qcom/qcom,msm8998-gfx-mem-acc.yaml#
$schema: http://devicetree.org/meta-schemas/core.yaml#

title: Qualcomm MSM8998 GFX memory accelerator select

maintainers:
  - Ankur Verma <ankur.verma@outlook.com>

description:
  The memories on the MSM8998 graphics rail (VDD_GFX) have a memory
  accelerator (mem-acc) select bit in TCSR. Qualcomm's GFX CPR driver sets
  it to 1 for the 180-342 MHz GPU voltage corners and to 0 for the
  414-710 MHz corners, raising VDD_GFX before it selects 0 and selecting 1
  before it lowers VDD_GFX. Without a GFX CPR driver, a board that runs
  VDD_GFX at a fixed voltage at or above the 414 MHz corner voltage enables
  this node to select 0 at boot, which the GPU needs at 414 MHz and above.

properties:
  compatible:
    const: qcom,msm8998-gfx-mem-acc

  qcom,tcsr:
    $ref: /schemas/types.yaml#/definitions/phandle-array
    items:
      - items:
          - description: phandle to the TCSR syscon
          - description: offset of the GFX mem-acc select register
    description: TCSR register holding the GFX mem-acc select bit (bit 0)

required:
  - compatible
  - qcom,tcsr

additionalProperties: false

examples:
  - |
    gfx-mem-acc {
        compatible = "qcom,msm8998-gfx-mem-acc";
        qcom,tcsr = <&tcsr_regs_2 0xf004>;
    };
```

## Documentation/devicetree/bindings/usb/qcom,pmi8998-typec.yaml
```yaml
# SPDX-License-Identifier: (GPL-2.0-only OR BSD-2-Clause)
%YAML 1.2
---
$id: http://devicetree.org/schemas/usb/qcom,pmi8998-typec.yaml#
$schema: http://devicetree.org/meta-schemas/core.yaml#

title: Qualcomm PMI8998 USB Type-C and PD PHY

maintainers:
  - Ankur Verma <ankur.verma@outlook.com>

description:
  The PMI8998 charger's USBIN Type-C block (CC detection, VCONN, role control)
  together with the PMIC's USB Power Delivery PHY, which is the same as the
  one in PM8150B.

properties:
  compatible:
    const: qcom,pmi8998-typec

  connector:
    type: object
    $ref: /schemas/connector/usb-connector.yaml#
    unevaluatedProperties: false

  reg:
    items:
      - description: Type-C register base offset
      - description: PD PHY register base offset

  interrupts:
    items:
      - description: Type-C change (CC state, debounce done, VBUS)
      - description: PD signal TX - HardReset or CableReset signal TX
      - description: PD signal RX - HardReset or CableReset signal RX
      - description: PD TX complete
      - description: PD RX complete
      - description: PD TX fail
      - description: PD TX message discard
      - description: PD RX message discard

  interrupt-names:
    items:
      - const: type-c-change
      - const: sig-tx
      - const: sig-rx
      - const: msg-tx
      - const: msg-rx
      - const: msg-tx-failed
      - const: msg-tx-discarded
      - const: msg-rx-discarded

  vdd-pdphy-supply:
    description: VDD regulator supply to the PD PHY.

required:
  - compatible
  - reg
  - interrupts
  - interrupt-names
  - vdd-pdphy-supply
  - connector

additionalProperties: false

examples:
  - |
    #include <dt-bindings/interrupt-controller/irq.h>
    #include <dt-bindings/usb/pd.h>

    pmic {
        #address-cells = <1>;
        #size-cells = <0>;

        typec@1300 {
            compatible = "qcom,pmi8998-typec";
            reg = <0x1300>, <0x1700>;
            interrupts = <0x2 0x13 0x7 IRQ_TYPE_EDGE_RISING>,
                         <0x2 0x17 0x0 IRQ_TYPE_EDGE_RISING>,
                         <0x2 0x17 0x1 IRQ_TYPE_EDGE_RISING>,
                         <0x2 0x17 0x2 IRQ_TYPE_EDGE_RISING>,
                         <0x2 0x17 0x3 IRQ_TYPE_EDGE_RISING>,
                         <0x2 0x17 0x4 IRQ_TYPE_EDGE_RISING>,
                         <0x2 0x17 0x5 IRQ_TYPE_EDGE_RISING>,
                         <0x2 0x17 0x6 IRQ_TYPE_EDGE_RISING>;
            interrupt-names = "type-c-change",
                              "sig-tx",
                              "sig-rx",
                              "msg-tx",
                              "msg-rx",
                              "msg-tx-failed",
                              "msg-tx-discarded",
                              "msg-rx-discarded";
            vdd-pdphy-supply = <&vreg_l24a_3p075>;

            connector {
                compatible = "usb-c-connector";
                power-role = "sink";
                data-role = "dual";
                self-powered;
                sink-pdos = <PDO_FIXED(5000, 3000, PDO_FIXED_DUAL_ROLE |
                                                   PDO_FIXED_USB_COMM)>;
                op-sink-microwatt = <10000000>;
                vbus-supply = <&pmi8998_vbus>;
            };
        };
    };
...
```
